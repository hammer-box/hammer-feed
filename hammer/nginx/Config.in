## hammer/nginx/Config.in
```kconfig
#
# Copyright (C) 2010 OpenWrt.org
#
# This is free software, licensed under the GNU General Public License v2.
# See /LICENSE for more information.
#

menu "Configuration"
        depends on PACKAGE_nginx
config NGINX_MEMC
	bool
	prompt "Enable memc  module"
	default n
	help
		Embed the power of Lua into nginx very easy.

config NGINX_EMEMC
	bool
	prompt "Enable memc  module"
	default n
	help
		An extended version of the standard memcached module that supports set, add, delete, and many more memcached commands.

config NGINX_AUTHPAM
	bool
	prompt "Enable auth pam  module"
	default n
	help
		HTTP Basic Authentication using PAM.

config NGINX_SLOWFS
	bool
	prompt "Enable slow fs module"
	default n
	help
		Module adding ability to cache static files.

config NGINX_AUTHDIGEST
	bool
	prompt "Enable auth digest  module"
	default n
	help
		HTTP Digest Authentication.

config NGINX_FANCYINDEX
	bool
	prompt "Enable fancy index module"
	default n
	help
		Like the built-in autoindex module, but fancier.

config NGINX_LUAFILE
	bool
	prompt "Enable lua file module"
	default n
	help
		Embed the power of Lua into nginx very easy.

config NGINX_LUA
	bool
	prompt "Enable chaoslawful nginx lua module"
	default n
	help
		Embed the power of Lua into nginx
		
config NGINX_STUB_STATUS
	bool
	prompt "Enable stub status module"
	default n
	help
		Enable the stub status module which gives some status from the server.

config NGINX_MP4
	bool
	prompt "Enable MP4 module"
	default n
	help
		Enables mp4 streaming with seeking ability.

config NGINX_XSLT
	bool
	prompt "Enable XSLT module"
	default n
	help
		Post-process pages with XSLT..

config NGINX_FLV
	bool
	prompt "Enable FLV module"
	default n
	help
		Provides the ability to seek within FLV (Flash) files using time-based offsets.

config NGINX_GZIP
	bool
	prompt "Enable GZIP module"
	default n
	help
		Serves precompressed versions of static files.

config NGINX_SSL
	bool
	prompt "Enable SSL module"
	default n
	help
		Enable HTTPS/SSL support.

config NGINX_DAV
	bool
	prompt "Enable WebDAV module"
	default n
	help
		Enable the HTTP and WebDAV methods PUT, DELETE, MKCOL, COPY and MOVE.

endmenu
```
